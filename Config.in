## Config.in
```kconfig
menu "Applications"
	source "$BR2_EXTERNAL_EUREKA_PATH/package/flashcast-flasher/Config.in"
endmenu

menu "Hardware support"
	source "$BR2_EXTERNAL_EUREKA_PATH/package/set-led/Config.in"
	source "$BR2_EXTERNAL_EUREKA_PATH/package/fts-utils/Config.in"
endmenu
```

## configs/eureka_basic_defconfig
```kconfig
BR2_arm=y
BR2_cortex_a9=y
BR2_ARM_EABIHF=y
BR2_ARM_ENABLE_NEON=y
BR2_ARM_FPU_NEON=y
BR2_COMPILER_PARANOID_UNSAFE_PATH=y
BR2_TOOLCHAIN_BUILDROOT_LOCALE=y
BR2_TOOLCHAIN_BUILDROOT_CXX=y
BR2_TARGET_GENERIC_HOSTNAME="chromecast"
BR2_TARGET_GENERIC_ISSUE="Welcome to tchebb's Chromecast image!"
BR2_ROOTFS_DEVICE_CREATION_DYNAMIC_MDEV=y
BR2_TARGET_GENERIC_ROOT_PASSWD="letmein"
BR2_ROOTFS_OVERLAY="$(BR2_EXTERNAL_EUREKA_PATH)/board/tchebb/eureka/fs-overlay/"
BR2_ROOTFS_POST_IMAGE_SCRIPT="$(BR2_EXTERNAL_EUREKA_PATH)/board/tchebb/eureka/make-bootimg.sh"
BR2_LINUX_KERNEL=y
BR2_LINUX_KERNEL_CUSTOM_GIT=y
BR2_LINUX_KERNEL_CUSTOM_REPO_URL="https://github.com/team-eureka/eureka_linux.git"
BR2_LINUX_KERNEL_CUSTOM_REPO_VERSION="v1.6-1"
BR2_LINUX_KERNEL_DEFCONFIG="eureka_basic"
BR2_LINUX_KERNEL_APPENDED_ZIMAGE=y
BR2_LINUX_KERNEL_INTREE_DTS_NAME="berlin2cd-dongle"
BR2_PACKAGE_BUSYBOX_CONFIG="$(BR2_EXTERNAL_EUREKA_PATH)/board/tchebb/eureka/busybox-1.22.x.config"
BR2_PACKAGE_DOSFSTOOLS=y
BR2_PACKAGE_DOSFSTOOLS_FATLABEL=y
BR2_PACKAGE_DOSFSTOOLS_FSCK_FAT=y
BR2_PACKAGE_DOSFSTOOLS_MKFS_FAT=y
BR2_PACKAGE_E2FSPROGS=y
BR2_PACKAGE_E2FSPROGS_RESIZE2FS=y
BR2_PACKAGE_MTD=y
BR2_PACKAGE_SQUASHFS=y
BR2_PACKAGE_FTS_UTILS=y
BR2_PACKAGE_SET_LED=y
BR2_PACKAGE_DNSMASQ=y
# BR2_PACKAGE_DNSMASQ_TFTP is not set
BR2_PACKAGE_DROPBEAR=y
BR2_PACKAGE_HOSTAPD=y
BR2_PACKAGE_IW=y
BR2_PACKAGE_NTP=y
BR2_PACKAGE_NTP_SNTP=y
# BR2_PACKAGE_NTP_NTPD is not set
BR2_PACKAGE_WPA_SUPPLICANT=y
BR2_PACKAGE_KMOD=y
BR2_TARGET_ROOTFS_CPIO=y
BR2_TARGET_ROOTFS_CPIO_GZIP=y
# BR2_TARGET_ROOTFS_TAR is not set
```

## configs/eureka_directfb-blobs_defconfig
```kconfig
BR2_arm=y
BR2_cortex_a9=y
BR2_ARM_ENABLE_NEON=y
BR2_ARM_FPU_NEON=y
BR2_COMPILER_PARANOID_UNSAFE_PATH=y
BR2_TOOLCHAIN_EXTERNAL=y
BR2_TARGET_GENERIC_HOSTNAME="chromecast"
BR2_TARGET_GENERIC_ISSUE="Welcome to tchebb's Chromecast image!"
BR2_ROOTFS_DEVICE_CREATION_DYNAMIC_MDEV=y
BR2_TARGET_GENERIC_ROOT_PASSWD="letmein"
BR2_ROOTFS_OVERLAY="board/tchebb/eureka/fs-overlay/"
BR2_ROOTFS_POST_IMAGE_SCRIPT="board/tchebb/eureka/make-bootimg.sh"
BR2_LINUX_KERNEL=y
BR2_LINUX_KERNEL_CUSTOM_GIT=y
BR2_LINUX_KERNEL_CUSTOM_REPO_URL="https://github.com/team-eureka/eureka_linux.git"
BR2_LINUX_KERNEL_CUSTOM_REPO_VERSION="v1.6-1"
BR2_LINUX_KERNEL_DEFCONFIG="eureka_rootpart"
BR2_LINUX_KERNEL_APPENDED_ZIMAGE=y
BR2_LINUX_KERNEL_INTREE_DTS_NAME="berlin2cd-dongle"
BR2_PACKAGE_BUSYBOX_CONFIG="board/tchebb/eureka/busybox-1.22.x.config"
BR2_PACKAGE_DOSFSTOOLS=y
BR2_PACKAGE_DOSFSTOOLS_FATLABEL=y
BR2_PACKAGE_DOSFSTOOLS_FSCK_FAT=y
BR2_PACKAGE_DOSFSTOOLS_MKFS_FAT=y
BR2_PACKAGE_E2FSPROGS=y
BR2_PACKAGE_E2FSPROGS_RESIZE2FS=y
BR2_PACKAGE_MTD=y
BR2_PACKAGE_SQUASHFS=y
BR2_PACKAGE_DIRECTFB=y
# BR2_PACKAGE_DIRECTFB_KEYBOARD is not set
# BR2_PACKAGE_DIRECTFB_PS2MOUSE is not set
# BR2_PACKAGE_DIRECTFB_SERIALMOUSE is not set
# BR2_PACKAGE_DIRECTFB_TSLIB is not set
BR2_PACKAGE_DIRECTFB_EXAMPLES=y
BR2_PACKAGE_DIRECTFB_EXAMPLES_ANDI=y
BR2_PACKAGE_DIRECTFB_EXAMPLES_DOK=y
BR2_PACKAGE_DIRECTFB_EXAMPLES_FIRE=y
BR2_PACKAGE_DIRECTFB_EXAMPLES_KNUCKLES=y
BR2_PACKAGE_DIRECTFB_EXAMPLES_PARTICLE=y
BR2_PACKAGE_BERLIN_BLOBS=y
BR2_PACKAGE_FTS_UTILS=y
BR2_PACKAGE_RES_SHIM=y
BR2_PACKAGE_SET_LED=y
BR2_PACKAGE_ETNA_VIV=y
BR2_PACKAGE_ETNA_VIV_ABI_EUREKA=y
BR2_PACKAGE_MESA3D_ETNA_VIV=y
BR2_PACKAGE_DNSMASQ=y
# BR2_PACKAGE_DNSMASQ_TFTP is not set
BR2_PACKAGE_DROPBEAR=y
BR2_PACKAGE_HOSTAPD=y
BR2_PACKAGE_IW=y
BR2_PACKAGE_NTP=y
BR2_PACKAGE_NTP_SNTP=y
# BR2_PACKAGE_NTP_NTPD is not set
BR2_PACKAGE_WPA_SUPPLICANT=y
BR2_PACKAGE_KMOD=y
```

## configs/eureka_fb-devel_defconfig
```kconfig
BR2_arm=y
BR2_arm7tdmi=y
BR2_KERNEL_HEADERS_3_0=y
BR2_TOOLCHAIN_BUILDROOT_LARGEFILE=y
BR2_TOOLCHAIN_BUILDROOT_INET_IPV6=y
BR2_TOOLCHAIN_BUILDROOT_LOCALE=y
BR2_PTHREAD_DEBUG=y
BR2_TOOLCHAIN_BUILDROOT_CXX=y
BR2_TARGET_GENERIC_HOSTNAME="chromecast"
BR2_TARGET_GENERIC_ISSUE="Welcome to tchebb's Chromecast image!"
BR2_ROOTFS_DEVICE_CREATION_DYNAMIC_MDEV=y
BR2_TARGET_GENERIC_ROOT_PASSWD="letmein"
BR2_ROOTFS_OVERLAY="board/tchebb/eureka/fs-overlay/"
BR2_ROOTFS_POST_IMAGE_SCRIPT="board/tchebb/eureka/make-bootimg.sh"
BR2_LINUX_KERNEL=y
BR2_LINUX_KERNEL_CUSTOM_TARBALL=y
BR2_LINUX_KERNEL_CUSTOM_TARBALL_LOCATION="file://board/tchebb/eureka/linux-3.0.8.tar.gz"
BR2_LINUX_KERNEL_PATCH="board/tchebb/eureka/linux-3.0.8-patches/"
BR2_LINUX_KERNEL_USE_CUSTOM_CONFIG=y
BR2_LINUX_KERNEL_CUSTOM_CONFIG_FILE="board/tchebb/eureka/linux-3.0.8_fb-devel.config"
BR2_LINUX_KERNEL_ZIMAGE=y
BR2_PACKAGE_BUSYBOX_CONFIG="board/tchebb/eureka/busybox-1.21.x.config"
BR2_PACKAGE_GDB=y
BR2_PACKAGE_GDB_SERVER=y
BR2_PACKAGE_GDB_DEBUGGER=y
BR2_PACKAGE_FB_TEST_APP=y
BR2_PACKAGE_DOSFSTOOLS=y
BR2_PACKAGE_DOSFSTOOLS_FATLABEL=y
BR2_PACKAGE_DOSFSTOOLS_FSCK_FAT=y
BR2_PACKAGE_DOSFSTOOLS_MKFS_FAT=y
BR2_PACKAGE_E2FSPROGS=y
BR2_PACKAGE_E2FSPROGS_RESIZE2FS=y
BR2_PACKAGE_MTD=y
BR2_PACKAGE_SQUASHFS=y
BR2_PACKAGE_SET_LED=y
BR2_PACKAGE_ETNA_VIV=y
BR2_PACKAGE_ETNA_VIV_ABI_EUREKA=y
BR2_PACKAGE_FREETYPE=y
BR2_PACKAGE_JPEG=y
BR2_PACKAGE_DNSMASQ=y
# BR2_PACKAGE_DNSMASQ_TFTP is not set
BR2_PACKAGE_DROPBEAR=y
BR2_PACKAGE_HOSTAPD=y
BR2_PACKAGE_IW=y
BR2_PACKAGE_WPA_SUPPLICANT=y
BR2_PACKAGE_KMOD=y
```

## configs/eureka_flasher_defconfig
```kconfig
BR2_arm=y
BR2_arm7tdmi=y
BR2_KERNEL_HEADERS_3_0=y
BR2_TOOLCHAIN_BUILDROOT_LARGEFILE=y
BR2_TOOLCHAIN_BUILDROOT_INET_IPV6=y
BR2_TOOLCHAIN_BUILDROOT_LOCALE=y
BR2_TOOLCHAIN_BUILDROOT_CXX=y
BR2_TARGET_GENERIC_HOSTNAME="flashcast"
BR2_TARGET_GENERIC_ISSUE="Welcome to FlashCast!"
BR2_ROOTFS_DEVICE_CREATION_DYNAMIC_MDEV=y
BR2_TARGET_GENERIC_ROOT_PASSWD="letmein"
BR2_ROOTFS_OVERLAY="board/tchebb/eureka/fs-overlay/ board/tchebb/eureka/fs-overlay_flasher/"
BR2_ROOTFS_POST_IMAGE_SCRIPT="board/tchebb/eureka/make-bootimg.sh"
BR2_LINUX_KERNEL=y
BR2_LINUX_KERNEL_CUSTOM_TARBALL=y
BR2_LINUX_KERNEL_CUSTOM_TARBALL_LOCATION="file://board/tchebb/eureka/linux-3.0.8.tar.gz"
BR2_LINUX_KERNEL_PATCH="board/tchebb/eureka/linux-3.0.8-patches/"
BR2_LINUX_KERNEL_USE_CUSTOM_CONFIG=y
BR2_LINUX_KERNEL_CUSTOM_CONFIG_FILE="board/tchebb/eureka/linux-3.0.8_flasher.config"
BR2_LINUX_KERNEL_ZIMAGE=y
BR2_PACKAGE_BUSYBOX_CONFIG="board/tchebb/eureka/busybox-1.21.x_flasher.config"
BR2_PACKAGE_BUSYBOX_SHOW_OTHERS=y
BR2_PACKAGE_DOSFSTOOLS=y
BR2_PACKAGE_DOSFSTOOLS_FATLABEL=y
BR2_PACKAGE_DOSFSTOOLS_FSCK_FAT=y
BR2_PACKAGE_DOSFSTOOLS_MKFS_FAT=y
BR2_PACKAGE_E2FSPROGS=y
BR2_PACKAGE_E2FSPROGS_RESIZE2FS=y
BR2_PACKAGE_MTD=y
BR2_PACKAGE_SQUASHFS=y
BR2_PACKAGE_UNIONFS=y
BR2_PACKAGE_SET_LED=y
BR2_PACKAGE_DNSMASQ=y
# BR2_PACKAGE_DNSMASQ_TFTP is not set
BR2_PACKAGE_DROPBEAR=y
BR2_PACKAGE_HOSTAPD=y
BR2_PACKAGE_IW=y
BR2_PACKAGE_WPA_SUPPLICANT=y
BR2_PACKAGE_BASH=y
BR2_PACKAGE_FILE=y
BR2_PACKAGE_KMOD=y
BR2_TARGET_ROOTFS_CPIO=y
BR2_TARGET_ROOTFS_CPIO_GZIP=y
# BR2_TARGET_ROOTFS_TAR is not set
```

## configs/tchebb_chromecast_defconfig
```kconfig
BR2_arm=y
BR2_arm7tdmi=y
BR2_KERNEL_HEADERS_3_0=y
BR2_TOOLCHAIN_BUILDROOT_LARGEFILE=y
BR2_TOOLCHAIN_BUILDROOT_INET_IPV6=y
BR2_TOOLCHAIN_BUILDROOT_LOCALE=y
BR2_PTHREAD_DEBUG=y
BR2_TOOLCHAIN_BUILDROOT_CXX=y
BR2_TARGET_GENERIC_HOSTNAME="chromecast"
BR2_TARGET_GENERIC_ISSUE="Welcome to tchebb's Chromecast image!"
BR2_ROOTFS_DEVICE_CREATION_DYNAMIC_MDEV=y
BR2_ROOTFS_OVERLAY="board/tchebb/chromecast/fs-overlay/"
BR2_PACKAGE_BUSYBOX_CONFIG="board/tchebb/chromecast/busybox-1.21.x.config"
BR2_PACKAGE_GDB=y
BR2_PACKAGE_GDB_SERVER=y
BR2_PACKAGE_GDB_DEBUGGER=y
BR2_PACKAGE_FB_TEST_APP=y
BR2_PACKAGE_MTD=y
BR2_PACKAGE_FREETYPE=y
BR2_PACKAGE_JPEG=y
BR2_PACKAGE_LIBPNG=y
BR2_PACKAGE_DNSMASQ=y
# BR2_PACKAGE_DNSMASQ_TFTP is not set
BR2_PACKAGE_DROPBEAR=y
BR2_PACKAGE_HOSTAPD=y
BR2_PACKAGE_IW=y
BR2_PACKAGE_WPA_SUPPLICANT=y
BR2_PACKAGE_KMOD=y
BR2_PACKAGE_UTIL_LINUX=y
BR2_PACKAGE_UTIL_LINUX_LIBBLKID=y
BR2_LINUX_KERNEL=y
BR2_LINUX_KERNEL_CUSTOM_TARBALL=y
BR2_LINUX_KERNEL_CUSTOM_TARBALL_LOCATION="file://board/tchebb/chromecast/linux-3.0.8.tar.gz"
BR2_LINUX_KERNEL_PATCH="board/tchebb/chromecast/linux-3.0.8-patches/"
BR2_LINUX_KERNEL_USE_CUSTOM_CONFIG=y
BR2_LINUX_KERNEL_CUSTOM_CONFIG_FILE="board/tchebb/chromecast/linux-3.0.8.config"
BR2_LINUX_KERNEL_ZIMAGE=y
```

## package/berlin-blobs/Config.in
```kconfig
config BR2_PACKAGE_BERLIN_BLOBS
	bool "berlin-blobs"
	select BR2_PACKAGE_LIBEXIF
	help
	  Binary blobs for Marvell Berlin SoCs (taken from the Google Chromecast)
```

## package/etna_viv/Config.in
```kconfig
config BR2_PACKAGE_ETNA_VIV
	bool "etna_viv"
	select BR2_PACKAGE_LIBPNG
	depends on !BR2_PTHREADS_NONE
	help
	  User-space driver for the Vivante GCxxx series of embedded GPUs.

	  https://github.com/laanwj/etna_viv

	  Select the ABI version to match the "galcore" driver.

if BR2_PACKAGE_ETNA_VIV

choice
	prompt "Kernel driver ABI version"
	default BR2_PACKAGE_ETNA_VIV_ABIV2

config BR2_PACKAGE_ETNA_VIV_ABIV2
	bool "v2"

config BR2_PACKAGE_ETNA_VIV_ABIV4
	bool "v4"

config BR2_PACKAGE_ETNA_VIV_ABI_EUREKA
	bool "eureka"

endchoice

config BR2_PACKAGE_ETNA_VIV_PROFILER
	bool "Performance counters support"
	help
	  Enable support for performance counters in etna_viv library. This
	  MUST be enabled if if the kernel was built with performance counter
	  support. 

endif
```

## package/flashcast-flasher/Config.in
```kconfig
config BR2_PACKAGE_FLASHCAST_FLASHER
	bool "flashcast-flasher"
	select BR2_PACKAGE_SET_LED
	select BR2_PACKAGE_FTS_UTILS
	help
	  The set of shell scripts which power FlashCast's mod framework

	  https://github.com/tchebb/flashcast-flasher
```

## package/fts-utils/Config.in
```kconfig
config BR2_PACKAGE_FTS_UTILS
	bool "fts-utils"
	help
	  A set of utilities for reading and writing the Google TV's Flash Transaction Storage partition

	  https://github.com/team-eureka/fts-utils
```

## package/mesa3d-etna_viv/Config.in
```kconfig
config BR2_PACKAGE_MESA3D_ETNA_VIV
	bool "Mesa 3D Graphics Library for etna_viv"
	select BR2_PACKAGE_EXPAT
	select BR2_PACKAGE_LIBDRM
	select BR2_PACKAGE_HOST_LIBXML2_PYTHON
	depends on BR2_PACKAGE_ETNA_VIV
	help
	  Mesa 3D, an open-source implementation of the OpenGL specification.

if BR2_PACKAGE_MESA3D_ETNA_VIV

config BR2_PACKAGE_MESA3D_ETNA_VIV_DEBUG
	bool "Enable debug logging and assertions"
	default n

config BR2_PACKAGE_MESA3D_ETNA_VIV_EGL
	bool "Build the EGL library"
	select BR2_PACKAGE_HAS_LIBEGL
	default y

config BR2_PACKAGE_MESA3D_ETNA_VIV_GLES
	bool "Build the OpenGL ES 1.0/2.0 libraries"
	select BR2_PACKAGE_HAS_LIBGLES
	default y

config BR2_PACKAGE_MESA3D_ETNA_VIV_VG
	bool "Build the OpenVG library"
	select BR2_PACKAGE_HAS_OPENVG
	default n

config BR2_PACKAGE_PROVIDES_LIBEGL
	default "mesa3d-etna_viv" if BR2_PACKAGE_MESA3D_ETNA_VIV_EGL

config BR2_PACKAGE_PROVIDES_LIBGLES
	default "mesa3d-etna_viv" if BR2_PACKAGE_MESA3D_ETNA_VIV_GLES


endif
```

## package/res-shim/Config.in
```kconfig
config BR2_PACKAGE_RES_SHIM
	bool "res-shim"
	depends on BR2_PACKAGE_BERLIN_BLOBS
	depends on BR2_PACKAGE_DIRECTFB
	help
	  Sets the Chromecast's HDMI resolution for DirectFB.

	  https://github.com/team-eureka/res-shim
```

## package/set-led/Config.in
```kconfig
config BR2_PACKAGE_SET_LED
	bool "set-led"
	help
	  Sets the led color on the eureka dongle.

	  https://github.com/team-eureka/set-led
```

## package/zip/Config.in
```kconfig
config BR2_PACKAGE_ZIP
	bool "zip"
	select BR2_PACKAGE_BZIP2
	help
	  zip is a compression and file packaging utility for Unix,
	  VMS, MSDOS, OS/2, Windows 9x/NT/XP, Minix, Atari, Macintosh,
	  MVS, z/OS, Amiga, Acorn RISC, and other OS.
	  It is analogous to a combination of the Unix commands tar(1)
	  and compress(1) (or tar(1) and gzip(1)) and is compatible
	  with PKZIP (Phil Katz's ZIP for MSDOS systems) and other
	  major zip utilities.
	  
	  http://www.info-zip.org/pub/infozip/
```
